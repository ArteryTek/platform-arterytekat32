# AT32A403Axx_v2 register map
Vendor: Keil; Series: AT32A403A; File version: 1.0
ARM 32-bit Cortex-M4 Microcontroller based device, CPU clock up to 200MHz, etc.
CPU: CM4 r0p1, little endian, no MPU, FPU, 4 interrupt priority bits
Registers are 32-bit, read-write, reset 0x0 unless marked. A register's access mark holds for its fields unless they carry their own. Offsets are from the block's base; lines under a group give offsets from that group; [hi:lo] are bit positions; {n}, {i} and the like mark numbered series; 'fields as' and 'values as' point back to an identical list; <NAME> marks a mode.

## Memory map
0x40000000 TMR2 size 0x400 — General purpose timer
0x40000400 TMR3 size 0x400 — General purpose timer
0x40000800 TMR4 size 0x400
0x40000C00 TMR5 size 0x400
0x40001000 TMR6 size 0x400 — Basic timer
0x40001400 TMR7 size 0x400
0x40001800 TMR12 size 0x400
0x40001C00 TMR13 size 0x400
0x40002000 TMR14 size 0x400
0x40002800 RTC size 0x400 — Real time clock
0x40002C00 WWDT size 0x400 — Window watchdog
0x40003000 WDT size 0x400 — Watchdog
0x40003800 SPI2 size 0x400
0x40003C00 SPI3 size 0x400
0x40004000 SPI4 size 0x400
0x40004400 USART2 size 0x400
0x40004800 USART3 size 0x400
0x40004C00 UART4 size 0x400 — Universal asynchronous receiver transmitter
0x40005000 UART5 size 0x400 — Universal asynchronous receiver transmitter
0x40005400 I2C1 size 0x400 — Inter integrated circuit
0x40005800 I2C2 size 0x400
0x40005C00 USBFS size 0x400 — Universal serial bus full-speed device interface
0x40006400 CAN1 size 0x400 — Can controller area network
0x40006800 CAN2 size 0x400
0x40006C04 BPR size 0x3FC — Battery powered register
0x40007000 PWC size 0x400 — Power control
0x40007400 DAC size 0x400 — Digital to analog converter
0x40010000 IOMUX size 0x400 — IO MUX function
0x40010400 EXINT size 0x400
0x40010800 GPIOA size 0x400 — General purpose IO
0x40010C00 GPIOB size 0x400
0x40011000 GPIOC size 0x400
0x40011400 GPIOD size 0x400
0x40011800 GPIOE size 0x400
0x40012400 ADC1 size 0x400 — Analog to digital converter
0x40012800 ADC2 size 0x400 — Analog to digital converter
0x40012C00 TMR1 size 0x400 — Advanced timer
0x40013000 SPI1 size 0x400 — Serial peripheral interface
0x40013400 TMR8 size 0x400
0x40013800 USART1 size 0x400 — Universal synchronous asynchronous receiver transmitter
0x40013C00 ADC3 size 0x400 — Analog to digital converter
0x40014C00 TMR9 size 0x400 — General purpose timer
0x40015000 TMR10 size 0x400 — General purpose timer
0x40015400 TMR11 size 0x400
0x40015800 ACC size 0x400 — HICK Auto Clock Calibration
0x40015C00 I2C3 size 0x400
0x40016000 USART6 size 0x400
0x40016400 UART7 size 0x400 — Universal asynchronous receiver transmitter
0x40016800 UART8 size 0x400 — Universal asynchronous receiver transmitter
0x40016C00 I2S2_EXT size 0x400
0x40017000 I2S3_EXT size 0x400
0x40018000 SDIO1 size 0x400 — Secure digital input/output interface
0x40020000 DMA1 size 0x400 — DMA controller
0x40020400 DMA2 size 0x400
0x40021000 CRM size 0x400 — Clock and reset management
0x40022000 FLASH size 0x400 — Flash memory controler
0x40023000 CRC size 0x400 — CRC calculation unit
0x40023400 SDIO2 size 0x400
0x40028000 ETHERNET_MAC size 0x100 — Ethernet: media access control
0x40028100 ETHERNET_MMC size 0x100 — Ethernet: MAC management counters
0x40028700 ETHERNET_PTP size 0x100 — Ethernet: Precision time protocol
0x40029000 ETHERNET_DMA size 0x100 — Ethernet: DMA controller operation
0xA0000000 XMC size 0x1000 — Flexible static memory controller
0xE000E000 NVIC size 0x1001 — Nested Vectored Interrupt Controller
0xE0042000 DEBUG size 0x400 — Debug support

## Interrupts
0 WWDT — Window Watchdog interrupt
1 PVM (EXINT) — PVM interrupt connect to EXINT line16
2 TAMPER (EXINT) — Tamper interrupt
3 RTC — RTC global interrupt
4 FLASH — Flash global interrupt
5 CRM — CRM global interrupt
6 EXINT0 (EXINT) — EXINT Line0 interrupt
7 EXINT1 (EXINT) — EXINT Line1 interrupt
8 EXINT2 (EXINT) — EXINT Line2 interrupt
9 EXINT3 (EXINT) — EXINT Line3 interrupt
10 EXINT4 (EXINT) — EXINT Line4 interrupt
11 DMA1_Channel1 (DMA1) — DMA1 Channel1 global interrupt
12 DMA1_Channel2 (DMA1) — DMA1 Channel2 global interrupt
13 DMA1_Channel3 (DMA1) — DMA1 Channel3 global interrupt
14 DMA1_Channel4 (DMA1) — DMA1 Channel4 global interrupt
15 DMA1_Channel5 (DMA1) — DMA1 Channel5 global interrupt
16 DMA1_Channel6 (DMA1) — DMA1 Channel6 global interrupt
17 DMA1_Channel7 (DMA1) — DMA1 Channel7 global interrupt
18 ADC1_2 (ADC1, ADC2) — ADC1 and ADC2 global interrupt
19 USBFS_H_CAN1_TX (CAN1) — CAN1 TX interrupt
20 USBFS_L_CAN1_RX0 (CAN1) — CAN1 RX0 interrupt
21 CAN_RX1 (CAN1) — CAN1 RX1 interrupt
22 CAN_SE (CAN1) — CAN1 SE interrupt
23 EXINT9_5 (EXINT) — EXINT Line[9:5] interrupts
24 TMR1_BRK_TMR9 (TMR1, TMR9) — TMR1 brake interrupt and TMR9 global interrupt
25 TMR1_OVF_TMR10 (TMR1, TMR10) — TMR1 overflow interrupt and TMR10 global interrupt
26 TMR1_TRG_HALL_TMR11 (TMR1, TMR11) — TMR1 trigger and HALL interrupts and TMR11 global interrupt
27 TMR1_CH (TMR1) — TMR1 channel interrupt
28 TMR2 — TMR2 global interrupt
29 TMR3 — TMR3 global interrupt
30 TMR4 — TMR4 global interrupt
31 I2C1_EVT (I2C1) — I2C1 event interrupt
32 I2C1_ERR (I2C1) — I2C1 error interrupt
33 I2C2_EVT (I2C2) — I2C2 event interrupt
34 I2C2_ERR (I2C2) — I2C2 error interrupt
35 SPI1 — SPI1 global interrupt
36 SPI2 — SPI2 global interrupt
37 USART1 — USART1 global interrupt
38 USART2 — USART2 global interrupt
39 USART3 — USART3 global interrupt
40 EXINT15_10 (EXINT) — EXINT Line[15:10] interrupts
41 RTCALARM (EXINT) — RTC Alarm interrupt connect to EXINT line17
42 USBFSWakeUp (EXINT) — USB Device FS Wakeup interrupt connect to EXINT line18
43 TMR8_BRK_TMR12 (TMR8, TMR12) — TMR8 brake interrupt and TMR12 global interrupt
44 TMR8_OVF_TMR13 (TMR8, TMR13) — TMR8 overflow interrupt and TMR13 global interrupt
45 TMR8_TRG_HALL_TMR14 (TMR8, TMR14) — TMR8 trigger and HALL interrupts and TMR14 global interrupt
46 TMR8_CH (TMR8) — TMR8 channel interrupt
47 ADC3 — ADC3 global interrupt
48 XMC — XMC global interrupt
49 SDIO1 — SDIO1 global interrupt
50 TMR5 — TMR5 global interrupt
51 SPI3 — SPI3 global interrupt
52 UART4 — UART4 global interrupt
53 UART5 — UART5 global interrupt
54 TMR6 — TMR6 global interrupt
55 TMR7 — TMR7 global interrupt
56 DMA2_Channel1 (DMA2) — DMA2 Channel1 global interrupt
57 DMA2_Channel2 (DMA2) — DMA2 Channel2 global interrupt
58 DMA2_Channel3 (DMA2) — DMA2 Channel3 global interrupt
59 DMA2_Channel4_5 (DMA2) — DMA2 Channel4 and DMA2 Channel5 global interrupt
60 SDIO2 — SDIO2 global interrupt
61 I2C3_EVT (I2C3) — I2C3 event interrupt
62 I2C3_ERR (I2C3) — I2C3 error interrupt
63 SPI4 — SPI4 global interrupt
68 CAN2_TX (CAN2) — CAN2 TX interrupt
69 CAN2_RX0 (CAN2) — CAN2 RX0 interrupt
70 CAN2_RX1 (CAN2) — CAN2 RX1 interrupt
71 CAN2_SE (CAN2) — CAN2 SE interrupt
75 DMA2_Channel6_7 (DMA2) — DMA2 Channel6 and DMA2 Channel7 global interrupt
76 USART6 — USART6 global interrupt
77 UART7 — UART7 global interrupt
78 UART8 — UART8 global interrupt
79 EMAC (ETHERNET_MAC) — Ethernet mac global interrupt
80 EMAC_WKUP (EXINT) — EMAC_WKUP interrupt connect to EXINT line19

## Licence text in the file
ARM Limited (ARM) is supplying this software for use with Cortex-M processor based microcontroller, but can be equally used for other suitable processor architectures. This file can be freely distributed. Modifications to this file shall be clearly marked. . THIS SOFTWARE IS PROVIDED "AS IS". NO WARRANTIES, WHETHER EXPRESS, IMPLIED. OR STATUTORY, INCLUDING, BUT NOT LIMITED TO, IMPLIED WARRANTIES OF. MERCHANTABILITY AND FITNESS FOR A PARTICULAR PURPOSE APPLY TO THIS SOFTWARE. ARM SHALL NOT, IN ANY CIRCUMSTANCES, BE LIABLE FOR SPECIAL, INCIDENTAL, OR. CONSEQUENTIAL DAMAGES, FOR ANY REASON WHATSOEVER.

## Notices in the file
Copyright (C) 2012-2014 ARM Limited. All rights reserved.
Purpose: System Viewer Description (SVD) Example (Schema Version 1.1)
This is a description of a none-existent and incomplete device
for demonstration purposes only.
Redistribution and use in source and binary forms, with or without
modification, are permitted provided that the following conditions are met:
- Redistributions of source code must retain the above copyright
notice, this list of conditions and the following disclaimer.
- Redistributions in binary form must reproduce the above copyright
notice, this list of conditions and the following disclaimer in the
documentation and/or other materials provided with the distribution.
- Neither the name of ARM nor the names of its contributors may be used
to endorse or promote products derived from this software without
specific prior written permission.
THIS SOFTWARE IS PROVIDED BY THE COPYRIGHT HOLDERS AND CONTRIBUTORS "AS IS"
AND ANY EXPRESS OR IMPLIED WARRANTIES, INCLUDING, BUT NOT LIMITED TO, THE
ARE DISCLAIMED. IN NO EVENT SHALL COPYRIGHT HOLDERS AND CONTRIBUTORS BE
LIABLE FOR ANY DIRECT, INDIRECT, INCIDENTAL, SPECIAL, EXEMPLARY, OR
CONSEQUENTIAL DAMAGES (INCLUDING, BUT NOT LIMITED TO, PROCUREMENT OF
SUBSTITUTE GOODS OR SERVICES; LOSS OF USE, DATA, OR PROFITS; OR BUSINESS
INTERRUPTION) HOWEVER CAUSED AND ON ANY THEORY OF LIABILITY, WHETHER IN
CONTRACT, STRICT LIABILITY, OR TORT (INCLUDING NEGLIGENCE OR OTHERWISE)
ARISING IN ANY WAY OUT OF THE USE OF THIS SOFTWARE, EVEN IF ADVISED OF THE
POSSIBILITY OF SUCH DAMAGE.
