# AT32M416xx_v2 register map
Vendor: Keil; Series: AT32M416; File version: 1.0
ARM 32-bit Cortex-M4 Microcontroller based device, CPU clock up to 120MHz, etc.
CPU: CM4 r0p1, little endian, no MPU, FPU, 4 interrupt priority bits
Registers are 32-bit, read-write, reset 0x0 unless marked. A register's access mark holds for its fields unless they carry their own. Offsets are from the block's base; lines under a group give offsets from that group; [hi:lo] are bit positions; {n}, {i} and the like mark numbered series; 'fields as' and 'values as' point back to an identical list; <NAME> marks a mode.

## Memory map
0x40000400 TMR3 size 0x400 — General purpose timer
0x40000800 TMR4 size 0x400
0x40001000 TMR6 size 0x400 — Basic timer
0x40001400 TMR7 size 0x400
0x40002800 ERTC size 0x400 — Real-time clock
0x40002C00 WWDT size 0x400 — Window watchdog
0x40003000 WDT size 0x400 — Watchdog
0x40003800 SPI2 size 0x400
0x40004400 USART2 size 0x400
0x40005400 I2C1 size 0x400 — Inter-integrated circuit
0x40005800 I2C2 size 0x400
0x40006400 CAN1 size 0x400 — controller area network
0x40007000 PWC size 0x400 — Power control
0x40007400 DAC size 0x400 — Digital to analog converter
0x40010000 TMR1 size 0x400 — Advanced timer
0x40011000 USART1 size 0x400 — Universal synchronous asynchronous receiver transmitter
0x40012000 ADC1 size 0x100 — Analog to digital converter
0x40012100 ADC2 size 0x100
0x40012300 ADCCOM size 0x100 — ADC common area
0x40013000 SPI1 size 0x400 — Serial peripheral interface
0x40013800 SCFG size 0x400 — System configuration controller
0x40013830 CMP size 0x400 — Comparator
0x40013B00 OP size 0x40 — Operational amplifiers
0x40013C00 EXINT size 0x400
0x40014000 TMR9 size 0x400 — General purpose timer
0x40014400 TMR10 size 0x400 — General purpose timer
0x40014800 TMR11 size 0x400
0x40017400 ACC size 0x400 — HICK Auto Clock Calibration
0x40020000 GPIOA size 0x400 — General purpose I/Os
0x40020400 GPIOB size 0x400
0x40020800 GPIOC size 0x400
0x40020C00 GPIOD size 0x400
0x40021000 GPIOE size 0x400
0x40021400 GPIOF size 0x400
0x40023000 CRC size 0x400 — CRC calculation unit
0x40023800 CRM size 0x400 — Clock and reset management
0x40023C00 FLASH size 0x400 — Flash memory controler
0x40026000 DMA1 size 0x200 — DMA controller
0x50000000 USB_OTGFS_GLOBAL size 0x400 — USB on-the-go full speed
0x50000400 USB_OTGFS_HOST size 0x400 — USB on the go full speed
0x50000800 USB_OTGFS_DEVICE size 0x400 — USB on the go full speed
0x50000E00 USB_OTGFS_PWRCLK size 0x400 — USB on the go full speed
0xA0001000 QSPI1 size 0x400 — Quad SPI Controller
0xA0002000 QSPI2 size 0x400
0xE000E000 NVIC size 0x1001 — Nested Vectored Interrupt Controller
0xE0042000 DEBUG size 0x400 — Debug support

## Interrupts
0 WWDT — Window Watchdog interrupt
1 PVM (EXINT) — PVM interrupt connect to EXINT line16
2 ERTC_TAMP_STAMP (EXINT) — ERTC Tamper and Stamp interrupt connect to EXINT line19
3 ERTC_WAKUP (EXINT) — ERTC wakeup interrupt connect to EXINT line20
4 FLASH — Flash global interrupt
5 CRM — CRM global interrupt
6 EXINT0 (EXINT) — EXINT Line0 interrupt
7 EXINT1 (EXINT) — EXINT Line1 interrupt
8 EXINT2 (EXINT) — EXINT Line2 interrupt
9 EXINT3 (EXINT) — EXINT Line3 interrupt
10 EXINT4 (EXINT) — EXINT Line4 interrupt
11 DMA1_Channel1 (DMA1) — DMA1 Channel1 global interrupt
12 DMA1_Channel2 (DMA1) — DMA1 Channel2 global interrupt
13 DMA1_Channel3 (DMA1) — DMA1 Channel3 global interrupt
14 DMA1_Channel4 (DMA1) — DMA1 Channel4 global interrupt
15 DMA1_Channel5 (DMA1) — DMA1 Channel5 global interrupt
16 DMA1_Channel6 (DMA1) — DMA1 Channel6 global interrupt
17 DMA1_Channel7 (DMA1) — DMA1 Channel7 global interrupt
18 ADC (ADC1) — ADC1 global interrupt
19 CAN1_TX (CAN1) — CAN1 TX interrupt
20 CAN1_RX (CAN1) — CAN1 RX interrupt
21 CAN1_STAT (CAN1) — CAN1 STAT interrupt
22 CAN1_ERR (CAN1) — CAN1 ERROR interrupt
23 EXINT9_5 (EXINT) — EXINT Line[9:5] interrupts
24 TMR1_BRK_TMR9 (TMR1) — TMR1 brake interrupt and TMR9 global interrupt
25 TMR1_OVF_TMR10 (TMR1) — TMR1 overflow interrupt and TMR10 global interrupt
26 TMR1_TRG_HALL_TMR11 (TMR1) — TMR1 trigger and HALL interrupts and TMR11 global interrupt
27 TMR1_CH (TMR1) — TMR1 channel interrupt
29 TMR3 — TMR3 global interrupt
30 TMR4 — TMR4 global interrupt
31 I2C1_EVT (I2C1) — I2C1 event interrupt
32 I2C1_ERR (I2C1) — I2C1 error interrupt
33 I2C2_EVT (I2C2) — I2C2 event interrupt
34 I2C2_ERR (I2C2) — I2C2 error interrupt
35 SPI1 — SPI1 global interrupt
36 SPI2 — SPI2 global interrupt
37 USART1 — USART1 global interrupt
38 USART2 — USART2 global interrupt
40 EXINT15_10 (EXINT) — EXINT Line[15:10] interrupts
41 ERTCALARM (EXINT) — ERTC Alarm interrupt connect to EXINT line17
54 TMR6 — TMR6 global interrupt
55 TMR7 — TMR7 global interrupt
64 CMP2_1_WAKUP (EXINT) — CMP 2 and 1 interrupt connect to EXINT line[22:21]
67 OTGFS1 (USB_OTGFS_GLOBAL) — USB On The Go FS global interrupt
91 QSPI2 — QSPI2 global interrupt
92 QSPI1 — QSPI1 global interrupt

## Licence text in the file
ARM Limited (ARM) is supplying this software for use with Cortex-M processor based microcontroller, but can be equally used for other suitable processor architectures. This file can be freely distributed. Modifications to this file shall be clearly marked. . THIS SOFTWARE IS PROVIDED "AS IS". NO WARRANTIES, WHETHER EXPRESS, IMPLIED. OR STATUTORY, INCLUDING, BUT NOT LIMITED TO, IMPLIED WARRANTIES OF. MERCHANTABILITY AND FITNESS FOR A PARTICULAR PURPOSE APPLY TO THIS SOFTWARE. ARM SHALL NOT, IN ANY CIRCUMSTANCES, BE LIABLE FOR SPECIAL, INCIDENTAL, OR. CONSEQUENTIAL DAMAGES, FOR ANY REASON WHATSOEVER.

## Notices in the file
Copyright (C) 2012-2014 ARM Limited. All rights reserved.
Purpose: System Viewer Description (SVD) Example (Schema Version 1.1)
This is a description of a none-existent and incomplete device
for demonstration purposes only.
Redistribution and use in source and binary forms, with or without
modification, are permitted provided that the following conditions are met:
- Redistributions of source code must retain the above copyright
notice, this list of conditions and the following disclaimer.
- Redistributions in binary form must reproduce the above copyright
notice, this list of conditions and the following disclaimer in the
documentation and/or other materials provided with the distribution.
- Neither the name of ARM nor the names of its contributors may be used
to endorse or promote products derived from this software without
specific prior written permission.
THIS SOFTWARE IS PROVIDED BY THE COPYRIGHT HOLDERS AND CONTRIBUTORS "AS IS"
AND ANY EXPRESS OR IMPLIED WARRANTIES, INCLUDING, BUT NOT LIMITED TO, THE
ARE DISCLAIMED. IN NO EVENT SHALL COPYRIGHT HOLDERS AND CONTRIBUTORS BE
LIABLE FOR ANY DIRECT, INDIRECT, INCIDENTAL, SPECIAL, EXEMPLARY, OR
CONSEQUENTIAL DAMAGES (INCLUDING, BUT NOT LIMITED TO, PROCUREMENT OF
SUBSTITUTE GOODS OR SERVICES; LOSS OF USE, DATA, OR PROFITS; OR BUSINESS
INTERRUPTION) HOWEVER CAUSED AND ON ANY THEORY OF LIABILITY, WHETHER IN
CONTRACT, STRICT LIABILITY, OR TORT (INCLUDING NEGLIGENCE OR OTHERWISE)
ARISING IN ANY WAY OUT OF THE USE OF THIS SOFTWARE, EVEN IF ADVISED OF THE
POSSIBILITY OF SUCH DAMAGE.
